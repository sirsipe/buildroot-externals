## Config.in
```kconfig
source "$BR2_EXTERNAL_SIRSIPE_EXTERNALS_PATH/package/hello-gps/Config.in"
source "$BR2_EXTERNAL_SIRSIPE_EXTERNALS_PATH/package/hello-i2c/Config.in"
source "$BR2_EXTERNAL_SIRSIPE_EXTERNALS_PATH/package/hello-raylib/Config.in"
source "$BR2_EXTERNAL_SIRSIPE_EXTERNALS_PATH/package/osd/Config.in"
source "$BR2_EXTERNAL_SIRSIPE_EXTERNALS_PATH/package/raylib/Config.in"
source "$BR2_EXTERNAL_SIRSIPE_EXTERNALS_PATH/package/rpi-wifi/Config.in"
```

## configs/rpi0w-uav_defconfig
```kconfig
BR2_arm=y
BR2_arm1176jzf_s=y
BR2_ARM_EABIHF=y

# Linux headers same as kernel, a 5.10 series
BR2_PACKAGE_HOST_LINUX_HEADERS_CUSTOM_5_10=y

BR2_TOOLCHAIN_BUILDROOT_CXX=y
BR2_TOOLCHAIN_BUILDROOT_WCHAR=y

BR2_LINUX_KERNEL=y
BR2_LINUX_KERNEL_CUSTOM_TARBALL=y
BR2_LINUX_KERNEL_CUSTOM_TARBALL_LOCATION="$(call github,raspberrypi,linux,0b54dbda3cca2beb51e236a25738784e90853b64)/linux-0b54dbda3cca2beb51e236a25738784e90853b64.tar.gz"
BR2_LINUX_KERNEL_DEFCONFIG="bcmrpi"
BR2_LINUX_KERNEL_DTS_SUPPORT=y
BR2_LINUX_KERNEL_INTREE_DTS_NAME="bcm2708-rpi-zero-w"
BR2_LINUX_KERNEL_NEEDS_HOST_OPENSSL=y

BR2_PACKAGE_RPI_FIRMWARE=y
BR2_PACKAGE_RPI_FIRMWARE_BOOTCODE_BIN=y
BR2_PACKAGE_RPI_FIRMWARE_VARIANT_PI_X=y
BR2_PACKAGE_RPI_FIRMWARE_CONFIG_FILE="$(BR2_EXTERNAL_SIRSIPE_EXTERNALS_PATH)/board/raspberrypi0w-uav/config_0w-uav.txt"

BR2_PACKAGE_RPI_USERLAND=y
BR2_PACKAGE_GPSD=y
BR2_PACKAGE_GPSD_DEVICES="/dev/ttyAMA0"
BR2_TARGET_GENERIC_GETTY=n

# Required tools to create the SD image
BR2_PACKAGE_HOST_DOSFSTOOLS=y
BR2_PACKAGE_HOST_GENIMAGE=y
BR2_PACKAGE_HOST_MTOOLS=y

# Filesystem / image
BR2_TARGET_ROOTFS_EXT2=y
BR2_TARGET_ROOTFS_EXT2_4=y
BR2_TARGET_ROOTFS_EXT2_SIZE="120M"
# BR2_TARGET_ROOTFS_TAR is not set
BR2_ROOTFS_POST_BUILD_SCRIPT="$(BR2_EXTERNAL_SIRSIPE_EXTERNALS_PATH)/board/raspberrypi0w-uav/post-build.sh"
BR2_ROOTFS_POST_IMAGE_SCRIPT="$(BR2_EXTERNAL_SIRSIPE_EXTERNALS_PATH)/board/raspberrypi0w-uav/post-image.sh"
```

## package/cam-on-start/Config.in
```kconfig
config BR2_PACKAGE_CAM_ON_START
	bool "cam-on-start"
    depends on BR2_PACKAGE_RPI_USERLAND
	help
	  Enable RPI Camera preview as fast as possible after boot.
```

## package/hello-gps/Config.in
```kconfig
config BR2_PACKAGE_HELLO_GPS
	bool "hello-gps"
	help
	  Testing c++ with gps library 
```

## package/hello-raylib/Config.in
```kconfig
config BR2_PACKAGE_HELLO_RAYLIB
	bool "hello-raylib"
	select BR2_PACKAGE_RAYLIB
	help
	  Testing raylib 
```

## package/osd-on-start/Config.in
```kconfig
config BR2_PACKAGE_OSD_ON_START
	bool "osd-on-start"
    depends on BR2_PACKAGE_OSD
	help
	  Launches OSD as last startup step.
```

## package/osd/Config.in
```kconfig
config BR2_PACKAGE_OSD
	bool "osd"
	depends on BR2_PTHREADS_NATIVE
	depends on BR2_PACKAGE_HAS_LIBGLES
	depends on BR2_USE_WCHAR
	select BR2_PACKAGE_RAYLIB
	help
	  On-Screen Display showing flight data 
```

## package/raylib/Config.in
```kconfig
config BR2_PACKAGE_RAYLIB
	bool "raylib"
	depends on BR2_PACKAGE_HAS_LIBGLES
	depends on BR2_USE_WCHAR
	help
	  https://github.com/raysan5/raylib
```

## package/rpi-wifi/Config.in
```kconfig
menuconfig BR2_PACKAGE_RPI_WIFI
	bool "rpi-wifi"
	select BR2_PACKAGE_BRCMFMAC_SDIO_FIRMWARE_RPI
	select BR2_PACKAGE_BRCMFMAC_SDIO_FIRMWARE_RPI_WIFI
	select BR2_PACKAGE_IFUPDOWN_SCRIPTS
	select BR2_PACKAGE_WPA_SUPPLICANT
	select BR2_PACKAGE_WPA_SUPPLICANT_NL80211
	help
	  This package configures WiFi for Raspberry Pi
	  and allows also configuring OpenSSH with root access,
	  resulting in very easy headless access for RPi devices over WiFi.
	  Selects also havenged to aid with random generator initialization 
	  with OpenSSH for significanly faster boot.
	  
	  You MUST first apply the _defconfig, i.e.
	     make raspberrypi0w_defconfig
	  or make raspberrypi3_defconfig
	  etc... 

	  Author: Simo Erkinheimo, 20.03.2022

if BR2_PACKAGE_RPI_WIFI

config BR2_PACKAGE_RPI_WIFI_MODPROBE
	bool "modprobe brcmfmac at inittab"
	default y
	depends on !BR2_PACKAGE_EUDEV
	help
	  This needs to be done if device management
	  does not automatically load the wifi module.
	  At least eudev automates this, but there might be
	  other packages too.

config BR2_PACKAGE_RPI_WIFI_SSID
	string "Wifi SSID"

config BR2_PACKAGE_RPI_WIFI_PWD
	string "Wifi Password"

config BR2_PACKAGE_RPI_WIFI_SSH_WITH_ROOT_LOGIN
	bool "OpenSSH Server with root login enabled + HAVENGED for faster boot"
	select BR2_PACKAGE_OPENSSH
	select BR2_PACKAGE_OPENSSH_SERVER
	select BR2_PACKAGE_HAVEGED
	
config BR2_TARGET_GENERIC_ROOT_PASSWD
	string "Root password (COMPULSORY!)"
	depends on BR2_PACKAGE_RPI_WIFI_SSH_WITH_ROOT_LOGIN

endif
```
